## apps/link_test/main/Kconfig.projbuild
```kconfig
menu "Link test"
    config LINK_TEST_PORT
        string "MCU serial port"
        default "uart:0:1:3"
        help
            uart:<num>:<tx>:<rx>.  uart:0:1:3 shares the console UART with
            the link (simulated MCU through tools/sim_bridge.py; logging is
            muted while the link runs).  uart:2:27:22 is the CYD -> SKR Pico
            wiring from the design document.
    choice LINK_TEST_WHICH
        prompt "Test to run"
        default LINK_TEST_M4_SDCARD
        config LINK_TEST_M2
            bool "M2: one axis"
        config LINK_TEST_M3
            bool "M3: CoreXY squares from printer.cfg"
        config LINK_TEST_M4
            bool "M4: homing (sensorless X/Y, switch Z)"
        config LINK_TEST_M4_SDCARD
            bool "M4: SD print with pause/resume/cancel (private data)"
        config LINK_TEST_UI_DEMO
            bool "M4: local UI demo (interactive, private data optional)"
            help
                Connects to the (simulated) MCU and runs the printer from the
                touch screen for LINK_TEST_DEMO_MINUTES.  Files: square.gcode
                and, when bench/data is present, card_opt.gcode.
        config LINK_TEST_M4_MACROS
            bool "M4: existing printer.cfg macros + drawing file"
            help
                Needs bench/data/fraxinus0pen_printer.cfg and
                bench/data/card_opt.gcode (private test data).
    endchoice
    config LINK_TEST_UI
        bool "Show the local UI (CYD display + touch)"
        default y
    config LINK_TEST_DEMO_MINUTES
        int "UI demo: minutes to run"
        default 20
        depends on LINK_TEST_UI_DEMO
    config LINK_TEST_MAX_LINES
        int "M4 macros: G-code lines to run"
        default 100000
    config LINK_TEST_DISTANCE
        int "M2 move distance (mm)"
        default 100
endmenu
```

## apps/plotter/main/Kconfig.projbuild
```kconfig
menu "Plotter"
    config PLOTTER_NETWORK
        bool "WiFi + Moonraker API (Mainsail)"
        default y if IDF_TARGET_ESP32S3
        default n
        help
            CoreS3: on.  CYD (no PSRAM): off, the board uses its touch
            screen and microSD card instead (design decision: the CYD has
            not enough RAM for WiFi next to the plotter).
    config PLOTTER_WIFI_SSID
        string "WiFi SSID"
        depends on PLOTTER_NETWORK
        default ""
    config PLOTTER_WIFI_PASSWORD
        string "WiFi password"
        depends on PLOTTER_NETWORK
        default ""
    config PLOTTER_AP_PASSWORD
        string "Access point password (empty = made per board)"
        depends on PLOTTER_NETWORK
        default ""
        help
            The board's own access point ESP32Klipper-XXXX: the setup one
            (opens without a saved network, or when the board cannot join
            it; setup page http://192.168.4.1/wifi) and access point mode
            (Mainsail at http://192.168.4.1/).  8 to 63 characters; empty
            = a password made once per board, shown on the touch screen
            (System tab and System -> WiFi).
    config PLOTTER_HOSTNAME
        string "Host name"
        depends on PLOTTER_NETWORK
        default "esp32klipper"
    config PLOTTER_CYD
        bool "CYD touch screen + microSD card"
        depends on IDF_TARGET_ESP32
        default y
        help
            ESP32-2432S028R: LVGL screen (Status / Files / Move) and the
            G-code files of the microSD card (SPI3: SCK 18, MISO 19,
            MOSI 23, CS 5).  Without a card, the files of the internal
            storage (/data/gcodes) are used.  printer.cfg in the card's
            root replaces the internal one.
    config PLOTTER_CORES3_SCREEN
        bool "CoreS3 touch screen"
        depends on IDF_TARGET_ESP32S3
        default y
        help
            The same screen as on the CYD (Status / Files / Move) next to
            Mainsail.
    config PLOTTER_CORES3_SD
        bool "CoreS3 microSD card"
        depends on IDF_TARGET_ESP32S3
        default y
        help
            G-code files from the card (/gcodes, or the root) and
            printer.cfg from its root, like on the CYD; Mainsail uploads
            and edits go to the card.  Without a card, the internal
            storage.  The card shares SPI2 with the display.
    config PLOTTER_SD_MHZ
        int "microSD SPI clock (MHz)"
        depends on PLOTTER_CYD || PLOTTER_CORES3_SD
        default 20
    config PLOTTER_MCU_PORT
        string "MCU serial port (empty = [mcu] serial of printer.cfg)"
        default ""
        help
            usbjtag (CoreS3) or uart:0:1:3 (CYD) to use the simulated MCU on
            the PC through tools/sim_bridge.py: the console then stays
            quiet while the link runs.
    config PLOTTER_AUTOSTART
        string "Print this file when ready (G28 X Y first; empty = off)"
        default ""
        help
            For trying the board without touching it, e.g. square.gcode
            (examples/) with the simulated MCU.
    config PLOTTER_SIM_HOMING
        bool "Simulated MCU: trigger the X/Y DIAG pins on G28"
        default n
endmenu
```

## apps/plotter/sdkconfig.defaults
```kconfig
CONFIG_ESP_DEFAULT_CPU_FREQ_MHZ_240=y
CONFIG_COMPILER_OPTIMIZATION_PERF=y
CONFIG_FREERTOS_HZ=1000
CONFIG_ESP_TASK_WDT_INIT=n
CONFIG_PTHREAD_TASK_STACK_SIZE_DEFAULT=3072
CONFIG_ESP_MAIN_TASK_STACK_SIZE=8192
CONFIG_VFS_SUPPORT_TERMIOS=y
CONFIG_PARTITION_TABLE_CUSTOM=y
# Mainsail's WebSocket and long file names on the FAT storage
CONFIG_HTTPD_WS_SUPPORT=y
CONFIG_HTTPD_MAX_URI_LEN=1024
CONFIG_HTTPD_MAX_REQ_HDR_LEN=2048
CONFIG_FATFS_LFN_HEAP=y
CONFIG_FATFS_MAX_LFN=255
CONFIG_FATFS_VFS_FSTAT_BLKSIZE=4096
CONFIG_FREERTOS_USE_TRACE_FACILITY=y
CONFIG_FREERTOS_USE_STATS_FORMATTING_FUNCTIONS=y
```

## components/cores3_board/Kconfig
```kconfig
menu "M5Stack CoreS3 board"
    config CORES3_LCD_PCLK_MHZ
        int "Display SPI clock (MHz)"
        default 40
    config CORES3_LCD_MADCTL
        hex "ILI9342C MADCTL (orientation / color order)"
        default 0x08
        help
            0x08: landscape, BGR.  0x00 if red and blue are swapped,
            0xC8 if the picture is upside down.
    config CORES3_LCD_INVERT
        bool "Invert display colors"
        default y
    config CORES3_TOUCH_SHOW
        bool "Show a dot where the screen is touched (check)"
        default n
endmenu
```

## components/cyd_board/Kconfig
```kconfig
menu "CYD board (ESP32-2432S028R)"
    choice CYD_LCD_CONTROLLER
        prompt "Display controller"
        default CYD_LCD_ILI9341
        help
            ESP32-2432S028R boards come with either display controller
            (the versions with two USB connectors usually have the ST7789).
        config CYD_LCD_ILI9341
            bool "ILI9341"
        config CYD_LCD_ST7789
            bool "ST7789"
    endchoice
    config CYD_LCD_PCLK_MHZ
        int "Display SPI clock (MHz)"
        default 40
    config CYD_LCD_MADCTL
        hex "Display MADCTL (orientation)"
        default 0x68 if CYD_LCD_ST7789
        default 0x28
        help
            0x28: landscape, USB connector on the right (MV + BGR); the
            ST7789 panels need 0x68 (MY flipped against the ILI9341).
            0xE8: landscape rotated 180 degrees (MX + MY + MV + BGR).
            Same bits on both controllers; 0x20 / 0xE0 if red and blue are
            swapped.
    config CYD_LCD_INVERT
        bool "Invert display colors"
        default y if CYD_LCD_ST7789
        default n
        help
            The ST7789 panels of the CYD need inverted colors (on), the
            ILI9341 ones do not.  Change it if black shows as white.
    config CYD_TOUCH_SWAP_XY
        bool "Touch: swap X and Y"
        default y if CYD_LCD_ST7789
        default n
    config CYD_TOUCH_X_MIN
        int "Touch: raw value at the left edge"
        default 200
    config CYD_TOUCH_X_MAX
        int "Touch: raw value at the right edge"
        default 3700
    config CYD_TOUCH_Y_MIN
        int "Touch: raw value at the top edge"
        default 240
    config CYD_TOUCH_Y_MAX
        int "Touch: raw value at the bottom edge"
        default 3800
    config CYD_TOUCH_SHOW
        bool "Show a dot where the screen is touched (calibration check)"
        default n
endmenu
```
